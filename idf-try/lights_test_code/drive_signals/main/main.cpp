#include <stdio.h>
#include <string.h>

#include "freertos/FreeRTOS.h"
#include "freertos/task.h"

#include "driver/gpio.h"

#include "esp_wifi.h"
#include "esp_now.h"
#include "esp_mac.h"
#include "esp_event.h"
#include "esp_netif.h"
#include "esp_system.h"
#include "esp_random.h"
#include "nvs_flash.h"


// ============================================================
// CONFIGURATION
// ============================================================

// Change this for each ESP32
//
// Head device = 0
// Other devices = 1, 2, 3, etc.
//
#define DEVICE_ID 2

#define HEAD_ID 0

// Change if your LED uses another GPIO
#define LED_GPIO GPIO_NUM_2

// Maximum number of hops a message can travel
#define DEFAULT_TTL 10

// How many recently seen messages to remember
#define MAX_SEEN_MESSAGES 30

// Maximum number of devices in network
#define MAX_DEVICES 10

// 255 means "all devices"
#define BROADCAST_ID 255


// ============================================================
// DEVICE MAC ADDRESSES
//
// PUT THE ACTUAL MAC ADDRESSES HERE
//
// Device IDs must match their position in this table.
//
// Example:
// Device 0 = HEAD
// Device 1 = first remote
// Device 2 = second remote
// ============================================================

uint8_t device_macs[MAX_DEVICES][6] = {

    // Device 0 - HEAD
    {0xE0, 0x5A, 0x1B, 0x75, 0x40, 0xC0}, //3

    // Device 1
    {0xE4, 0x65, 0xB8, 0x78, 0x9C, 0x20},  //swirly

    // Device 2
     {0xE0, 0x5A, 0x1B, 0x75, 0x57, 0xE4}, //#4

    // Device 3
    {0xC8, 0xF0, 0x9E, 0x2E, 0x10, 0x34},  //#6?

    // Device 4
    {0xA, 0xBB, 0xCC, 0xDD, 0xEE, 0x04},

    // Remaining unused entries
    {0, 0, 0, 0, 0, 0},
    {0, 0, 0, 0, 0, 0},
    {0, 0, 0, 0, 0, 0},
    {0, 0, 0, 0, 0, 0},
    {0, 0, 0, 0, 0, 0}
};

// Number of actual devices
#define NUM_DEVICES 5


// ============================================================
// MESSAGE TYPES
// ============================================================

enum MessageType : uint8_t {
    MSG_DISCOVER = 1,
    MSG_TEST,
    MSG_STATUS_REQUEST,
    MSG_STATUS_RESPONSE
};


// ============================================================
// MESSAGE STRUCTURE
// ============================================================

typedef struct {

    // New random number generated by HEAD at each startup
    uint32_t session_id;

    // Unique for each source device
    uint32_t message_id;

    // Device that originally created the message
    uint8_t source_id;

    // Device message is intended for
    // 255 = all devices
    uint8_t target_id;

    // Message type
    uint8_t type;

    // Number of times it may still be forwarded
    uint8_t ttl;

    // Optional command/data field
    uint8_t command;

    // Reserved for future status information
    uint16_t battery_mv;

} MeshMessage;


// ============================================================
// NEIGHBOR TABLE
// ============================================================
//
// A device becomes a neighbor if we actually receive
// a DISCOVER packet directly from it.
//

bool neighbors[MAX_DEVICES] = {false};


// ============================================================
// SEEN MESSAGE TABLE
// ============================================================

typedef struct {
    uint32_t session_id;
    uint32_t message_id;
    uint8_t source_id;
} SeenMessage;

SeenMessage seen_messages[MAX_SEEN_MESSAGES];
int seen_index = 0;


// ============================================================
// LOCAL MESSAGE COUNTER
// ============================================================

uint32_t next_message_id = 1;


// ============================================================
// NETWORK SESSION
// ============================================================

uint32_t session_id = 0;


// ============================================================
// LED
// ============================================================

void flash_led_twice()
{
    for (int i = 0; i < 2; i++) {

        gpio_set_level(LED_GPIO, 1);
        vTaskDelay(pdMS_TO_TICKS(100));

        gpio_set_level(LED_GPIO, 0);
        vTaskDelay(pdMS_TO_TICKS(100));
    }
}


// ============================================================
// CHECK IF MESSAGE WAS ALREADY SEEN
// ============================================================

bool message_already_seen(const MeshMessage *msg)
{
    for (int i = 0; i < MAX_SEEN_MESSAGES; i++) {

        if (seen_messages[i].session_id == msg->session_id &&
            seen_messages[i].message_id == msg->message_id &&
            seen_messages[i].source_id == msg->source_id) {

            return true;
        }
    }

    return false;
}


// ============================================================
// REMEMBER MESSAGE
// ============================================================

void remember_message(const MeshMessage *msg)
{
    seen_messages[seen_index].session_id =
        msg->session_id;

    seen_messages[seen_index].message_id =
        msg->message_id;

    seen_messages[seen_index].source_id =
        msg->source_id;

    seen_index++;

    if (seen_index >= MAX_SEEN_MESSAGES) {
        seen_index = 0;
    }
}


// ============================================================
// ADD ALL DEVICES AS ESP-NOW PEERS
// ============================================================

void add_all_peers()
{
    for (int i = 0; i < NUM_DEVICES; i++) {

        // Don't add ourselves
        if (i == DEVICE_ID) {
            continue;
        }

        esp_now_peer_info_t peer_info = {};

        memcpy(
            peer_info.peer_addr,
            device_macs[i],
            ESP_NOW_ETH_ALEN
        );

        peer_info.channel = 0;
        peer_info.ifidx = WIFI_IF_STA;
        peer_info.encrypt = false;

        esp_err_t result =
            esp_now_add_peer(&peer_info);

        if (result == ESP_OK) {

            printf(
                "Added Device %d as peer\n",
                i
            );

        } else if (
            result != ESP_ERR_ESPNOW_EXIST
        ) {

            printf(
                "Could not add Device %d: %s\n",
                i,
                esp_err_to_name(result)
            );
        }
    }
}


// ============================================================
// SEND MESSAGE TO ONE DEVICE
// ============================================================

void send_to_device(
    int device_id,
    const MeshMessage *msg
)
{
    if (device_id < 0 ||
        device_id >= NUM_DEVICES) {
        return;
    }

    if (device_id == DEVICE_ID) {
        return;
    }

    esp_err_t result = esp_now_send(
        device_macs[device_id],
        (const uint8_t *)msg,
        sizeof(MeshMessage)
    );

    if (result != ESP_OK) {

        printf(
            "Send to Device %d failed: %s\n",
            device_id,
            esp_err_to_name(result)
        );
    }
}


// ============================================================
// SEND MESSAGE TO ALL KNOWN NEIGHBORS
// ============================================================

void forward_to_neighbors(
    const MeshMessage *msg
)
{
    if (msg->ttl == 0) {
        printf("TTL expired - not forwarding\n");
        return;
    }

    MeshMessage forwarded = *msg;

    // One hop used
    forwarded.ttl--;

    for (int i = 0; i < NUM_DEVICES; i++) {

        if (neighbors[i]) {

            printf(
                "Forwarding message %lu to Device %d "
                "(TTL=%d)\n",
                (unsigned long)forwarded.message_id,
                i,
                forwarded.ttl
            );

            send_to_device(i, &forwarded);
        }
    }
}


// ============================================================
// SEND DISCOVER
// ============================================================

void send_discover()
{
    MeshMessage msg = {};

    msg.session_id = 0;
    msg.message_id = next_message_id++;
    msg.source_id = DEVICE_ID;
    msg.target_id = BROADCAST_ID;
    msg.type = MSG_DISCOVER;
    msg.ttl = 0;

    printf(
        "Device %d sending DISCOVER\n",
        DEVICE_ID
    );

    // During initial discovery, send directly
    // to every configured device.
    for (int i = 0; i < NUM_DEVICES; i++) {

        if (i == DEVICE_ID) {
            continue;
        }

        send_to_device(i, &msg);
    }
}


// ============================================================
// SEND TEST MESSAGE
// ============================================================

void send_test_message()
{
    MeshMessage msg = {};

    msg.session_id = session_id;
    msg.message_id = next_message_id++;
    msg.source_id = DEVICE_ID;
    msg.target_id = BROADCAST_ID;
    msg.type = MSG_TEST;
    msg.ttl = DEFAULT_TTL;

    // Remember our own message so it isn't
    // processed again if it comes back to us.
    remember_message(&msg);

    printf("\n");
    printf("================================\n");
    printf("HEAD SENDING TEST MESSAGE\n");
    printf("Session: %lu\n",
           (unsigned long)msg.session_id);
    printf("Message ID: %lu\n",
           (unsigned long)msg.message_id);
    printf("================================\n");

    forward_to_neighbors(&msg);
}


// ============================================================
// PRINT NEIGHBORS
// ============================================================

void print_neighbors()
{
    printf("\nDevice %d neighbors:\n", DEVICE_ID);

    bool found = false;

    for (int i = 0; i < NUM_DEVICES; i++) {

        if (neighbors[i]) {

            printf("  Device %d\n", i);
            found = true;
        }
    }

    if (!found) {
        printf("  NONE\n");
    }

    printf("\n");
}


// ============================================================
// RECEIVE CALLBACK
// ============================================================

void on_data_recv(
    const esp_now_recv_info_t *recv_info,
    const uint8_t *data,
    int len
)
{
    if (len != sizeof(MeshMessage)) {

        printf(
            "Unexpected packet size: %d\n",
            len
        );

        return;
    }

    MeshMessage msg;

    memcpy(
        &msg,
        data,
        sizeof(MeshMessage)
    );


    // --------------------------------------------------------
    // DISCOVERY
    // --------------------------------------------------------

    if (msg.type == MSG_DISCOVER) {

        if (msg.source_id < NUM_DEVICES &&
            msg.source_id != DEVICE_ID) {

            neighbors[msg.source_id] = true;

            printf(
                "DISCOVER received directly from "
                "Device %d\n",
                msg.source_id
            );
        }

        return;
    }


    // --------------------------------------------------------
    // NORMAL MESSAGE
    // --------------------------------------------------------

    // Ignore messages from a different session
    if (msg.session_id != session_id) {

        printf(
            "Ignoring old/wrong session message\n"
        );

        return;
    }


    // Check duplicate
    if (message_already_seen(&msg)) {

        printf(
            "Duplicate ignored: Source %d "
            "Message %lu\n",
            msg.source_id,
            (unsigned long)msg.message_id
        );

        return;
    }


    // Remember immediately before processing/forwarding
    remember_message(&msg);


    printf("\n");
    printf("--------------------------------\n");
    printf("NEW MESSAGE RECEIVED\n");
    printf("From source: %d\n", msg.source_id);
    printf("Message ID: %lu\n",
           (unsigned long)msg.message_id);
    printf("Type: %d\n", msg.type);
    printf("Target: %d\n", msg.target_id);
    printf("TTL: %d\n", msg.ttl);
    printf("--------------------------------\n");


    // Visible receipt indication
    flash_led_twice();


    // --------------------------------------------------------
    // PROCESS MESSAGE IF WE ARE THE TARGET
    // --------------------------------------------------------

    if (msg.target_id == DEVICE_ID ||
        msg.target_id == BROADCAST_ID) {

        switch (msg.type) {

            case MSG_TEST:

                printf(
                    "Device %d processed TEST message!\n",
                    DEVICE_ID
                );

                break;


            case MSG_STATUS_REQUEST:

                printf(
                    "Status request for Device %d\n",
                    DEVICE_ID
                );

                // We'll add actual battery/status
                // response next.

                break;


            default:

                printf(
                    "Unknown message type\n"
                );

                break;
        }
    }


    // --------------------------------------------------------
    // FORWARD MESSAGE
    // --------------------------------------------------------

    if (msg.ttl > 0) {

        forward_to_neighbors(&msg);
    }
}


// ============================================================
// APP MAIN
// ============================================================

extern "C" void app_main(void)
{
    printf("\n\n");
    printf("========================================\n");
    printf("ESP-NOW REPEATING MESH TEST\n");
    printf("DEVICE ID = %d\n", DEVICE_ID);
    printf("========================================\n");


    // --------------------------------------------------------
    // NVS
    // --------------------------------------------------------

    esp_err_t ret = nvs_flash_init();

    if (ret == ESP_ERR_NVS_NO_FREE_PAGES ||
        ret == ESP_ERR_NVS_NEW_VERSION_FOUND) {

        ESP_ERROR_CHECK(nvs_flash_erase());

        ret = nvs_flash_init();
    }

    ESP_ERROR_CHECK(ret);


    // --------------------------------------------------------
    // NETWORK
    // --------------------------------------------------------

    ESP_ERROR_CHECK(esp_netif_init());
    ESP_ERROR_CHECK(
        esp_event_loop_create_default()
    );

    wifi_init_config_t cfg =
        WIFI_INIT_CONFIG_DEFAULT();

    ESP_ERROR_CHECK(
        esp_wifi_init(&cfg)
    );

    ESP_ERROR_CHECK(
        esp_wifi_set_mode(WIFI_MODE_STA)
    );

    ESP_ERROR_CHECK(
        esp_wifi_start()
    );


    // --------------------------------------------------------
    // PRINT OUR MAC
    // --------------------------------------------------------

    uint8_t my_mac[6];

    ESP_ERROR_CHECK(
        esp_read_mac(
            my_mac,
            ESP_MAC_WIFI_STA
        )
    );

    printf(
        "My MAC: %02X:%02X:%02X:%02X:%02X:%02X\n",
        my_mac[0], my_mac[1], my_mac[2],
        my_mac[3], my_mac[4], my_mac[5]
    );


    // --------------------------------------------------------
    // LED
    // --------------------------------------------------------

    gpio_reset_pin(LED_GPIO);

    ESP_ERROR_CHECK(
        gpio_set_direction(
            LED_GPIO,
            GPIO_MODE_OUTPUT
        )
    );

    gpio_set_level(LED_GPIO, 0);


    // --------------------------------------------------------
    // ESP-NOW
    // --------------------------------------------------------

    ESP_ERROR_CHECK(
        esp_now_init()
    );

    ESP_ERROR_CHECK(
        esp_now_register_recv_cb(
            on_data_recv
        )
    );


    // --------------------------------------------------------
    // ADD PEERS
    // --------------------------------------------------------

    add_all_peers();


    // --------------------------------------------------------
    // CREATE / LEARN SESSION
    // --------------------------------------------------------

    if (DEVICE_ID == HEAD_ID) {

        // New network session each power-up
        session_id = esp_random();

        printf(
            "HEAD created Session ID: %lu\n",
            (unsigned long)session_id
        );

    } else {

        // Temporary value until discovery/test phase.
        // For the first test, all devices need the
        // same session ID.
        //
        // We will automatically distribute this
        // from HEAD in the next refinement.
        session_id = 123456;
    }


    // IMPORTANT:
    //
    // For this first test, temporarily use the
    // SAME fixed session ID on ALL devices.
    //
    // Change the HEAD assignment above to:
    //
    // session_id = 123456;
    //
    // Once basic repeating works, we'll add a
    // SESSION_START message from HEAD.


    session_id = 123456;


    // --------------------------------------------------------
    // DISCOVERY
    // --------------------------------------------------------

    // Give all devices time to boot
    vTaskDelay(pdMS_TO_TICKS(2000));

    send_discover();

    // Wait for all DISCOVER packets
    vTaskDelay(pdMS_TO_TICKS(3000));

    print_neighbors();


    // --------------------------------------------------------
    // HEAD TEST
    // --------------------------------------------------------

    if (DEVICE_ID == HEAD_ID) {

        // Give all devices a little extra time
        vTaskDelay(pdMS_TO_TICKS(2000));

        send_test_message();
    }


    // --------------------------------------------------------
    // KEEP RUNNING
    // --------------------------------------------------------

    while (1) {

        vTaskDelay(pdMS_TO_TICKS(1000));
    }
}